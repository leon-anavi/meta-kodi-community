## conf/layer.conf
```bitbake
# We have a conf and classes directory, add to BBPATH
BBPATH .= ":${LAYERDIR}"

# We have recipes-* directories, add to BBFILES
BBFILES += "${LAYERDIR}/recipes-*/*/*.bb \
            ${LAYERDIR}/recipes-*/*/*.bbappend"

BBFILE_COLLECTIONS += "meta-kodi-raspberrypi"
BBFILE_PATTERN_meta-kodi-raspberrypi = "^${LAYERDIR}/"
BBFILE_PRIORITY_meta-kodi-raspberrypi = "6"

LAYERDEPENDS_meta-kodi-raspberrypi = "core"
LAYERSERIES_COMPAT_meta-kodi-raspberrypi = "dunfell"
```

## meta-kodi-cubox-i/conf/layer.conf
```bitbake
# We have a conf and classes directory, add to BBPATH
BBPATH .= ":${LAYERDIR}"

# We have recipes-* directories, add to BBFILES
BBFILES += "${LAYERDIR}/recipes-*/*/*.bb \
            ${LAYERDIR}/recipes-*/*/*.bbappend"

BBFILE_COLLECTIONS += "meta-kodi-cubox-i"
BBFILE_PATTERN_meta-kodi-cubox-i = "^${LAYERDIR}/"
BBFILE_PRIORITY_meta-kodi-cubox-i = "6"

LAYERDEPENDS_meta-kodi-cubox-i = "core"
LAYERSERIES_COMPAT_meta-kodi-cubox-i = "dunfell"
```

## meta-kodi-distro/conf/distro/anavi-media-hub.conf
```bitbake
require conf/distro/poky.conf

DISTRO = "anavi-media-hub"
DISTRO_NAME = "ANAVI Media Hub"

# Switch to systemd
DISTRO_FEATURES_append = " systemd"
VIRTUAL-RUNTIME_init_manager = "systemd"
DISTRO_FEATURES_BACKFILL_CONSIDERED = "sysvinit"
VIRTUAL-RUNTIME_initscripts = ""

DISTRO_FEATURES_append = " pam"

# Use this specific version which is known to work with
# LibreELEC/OpenELEC settings add-on. With newer gobject
# versions based on GI the add-on hangs.
PREFERRED_VERSION_python-pygobject = "2.28.7"
PREFERRED_VERSION_python-pygobject-native = "2.28.7"
```

## meta-kodi-intel/conf/layer.conf
```bitbake
# We have a conf and classes directory, add to BBPATH
BBPATH .= ":${LAYERDIR}"

# We have recipes-* directories, add to BBFILES
BBFILES += "${LAYERDIR}/recipes-*/*/*.bb \
            ${LAYERDIR}/recipes-*/*/*.bbappend"

BBFILE_COLLECTIONS += "meta-kodi-intel"
BBFILE_PATTERN_meta-kodi-intel = "^${LAYERDIR}/"
BBFILE_PRIORITY_meta-kodi-intel = "6"

LAYERDEPENDS_meta-kodi-intel = "core"
LAYERSERIES_COMPAT_meta-kodi-intel = "dunfell"
```

## meta-kodi-meson/conf/layer.conf
```bitbake
# We have a conf and classes directory, add to BBPATH
BBPATH .= ":${LAYERDIR}"

# We have recipes-* directories, add to BBFILES
BBFILES += "${LAYERDIR}/recipes-*/*/*.bb \
            ${LAYERDIR}/recipes-*/*/*.bbappend"

BBFILE_COLLECTIONS += "meta-kodi-meson"
BBFILE_PATTERN_meta-kodi-meson = "^${LAYERDIR}/"
BBFILE_PRIORITY_meta-kodi-meson = "6"

LAYERDEPENDS_meta-kodi-meson = "core"
LAYERSERIES_COMPAT_meta-kodi-meson = "dunfell"
```
